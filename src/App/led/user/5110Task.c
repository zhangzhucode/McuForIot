/*********************************************************************************************************************
** 文件名称：nokia_5110_lcd  test                                                                                   **
** 作    者：zz                                                                                                     **
** 时    间: 2014.06.30                                                                                             **
** 简    介：在stm32/ucos2 上实现的nokia5110                                                                        **
*********************************************************************************************************************/    
#include <includes.h>
//#include "nokia_5110.h"
#include "5110Task.h"
//#include "MPU6050.h"
void content_16to10(s32 datain,char *s);
/********************************************************************************
;  源文件 / 文字 : AVR
;  宽×高（像素）: 40×24
;  字模格式/大小 : 单色点阵液晶字模，纵向取模，字节倒序/120字节
;  数据转换日期  : 2004-8-13
*********************************************************************************/
unsigned char AVR_bmp[]=
{
0x00,0x00,0x00,0x00,0x00,0x00,0x00,0x00,0x00,0x00,0x00,0x00,0x00,0x80,0xC0,0x40,
0x20,0x00,0x10,0x10,0x00,0x08,0x08,0x08,0x08,0x08,0x08,0x08,0x00,0x10,0x10,0x00,
0x20,0x40,0xC0,0x80,0x00,0x00,0x00,0x00,0x00,0x00,0x00,0x00,0x00,0x00,0x00,0x00,
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0x00,0x00,0x00,0x00,0x00,0x00,0x00,0x00,0x00,0x00,0x00,0x00,0x00,0x00
};

	

void LCD5110Task(void *pd)
{
		char val[20];
		nokia_LCD_init(); //初始化液晶    
		nokia_LCD_clear();
		while(1)  
		{
				nokia_LCD_write_english_string(0,0,"stm32/ucos2");
				nokia_LCD_write_english_string(0,1,"Standard");
				nokia_LCD_write_english_string(0,2,"Author: zzhere");
				nokia_LCD_write_english_string(0,3,"--------------");
				nokia_LCD_write_english_string(0,4,"tem:");
				content_16to10(MPU6050_tem,val);
				nokia_LCD_write_english_string(25,4,val);
				//nokia_LCD_write_chinese_string(12,4,12,4,0,5);
			
				OSTimeDly(OS_TICKS_PER_SEC);
		}	  
}

void content_16to10(s32 datain,char *s)
{
   s32 result = datain;
   u8  i ;
   *s = 0;
   *(s+1) = 0;
   *(s+2) = 0;
   *(s+3) = 0;
   *(s+4) = 0;
   if((result < 1000)&&(result>(-50)))
   {
	  if(result>=0)
	  {*s = ' '; }
	  else
	  {*s = '-';}
	  
	  *(s+1) = result/100 + 0x30;
	  *(s+2) = (result%100)/10+ 0x30;
	  *(s+3) = result%10 + 0x30;
	  for(i=1;i<4;i++)
	  {
	  		if(*(s+i) == 0x30)
	  		{ *(s+i) = ' ';}
	  }
   }
   else
   { *s = 0;}
}

